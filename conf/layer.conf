## conf/layer.conf
```bitbake
# We have a conf and classes directory, add to BBPATH
BBPATH .= ":${LAYERDIR}"

# We have recipes-* directories, add to BBFILES
BBFILES += "${LAYERDIR}/recipes-*/*/*.bb \
            ${LAYERDIR}/recipes-*/*/*.bbappend"

BBFILE_COLLECTIONS += "meta-x86-psabi"
BBFILE_PATTERN_meta-x86-psabi = "^${LAYERDIR}/"
BBFILE_PRIORITY_meta-x86-psabi = "6"

LAYERDEPENDS_meta-x86-psabi = "core"
LAYERSERIES_COMPAT_meta-x86-psabi = "honister"
```
